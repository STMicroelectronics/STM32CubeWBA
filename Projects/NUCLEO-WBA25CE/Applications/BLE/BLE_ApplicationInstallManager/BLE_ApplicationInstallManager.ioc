# file: BLE_ApplicationInstallManager.ioc
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CORTEX_M33_NS.userName=CORTEX_M33
Mcu.Family=STM32WBA
Mcu.Name=STM32WBA25CEUx
Mcu.Package=UFQFPN48_SMPS_USB
NVIC.PriorityGroup=NVIC_PRIORITYGROUP_4
NVIC.RCC_IRQn=true\:1\:0\:true\:false\:true\:true\:false\:true
OSC_IN.Mode=HSE-External-Oscillator
OSC_IN.PinAttribute=CortexM33
OSC_IN.Signal=RCC_OSC_IN
OSC_OUT.Mode=HSE-External-Oscillator
OSC_OUT.PinAttribute=CortexM33
OSC_OUT.Signal=RCC_OSC_OUT
PWR.pwrPrivilege=PWR_PRIVILEGE_NO
ProjectManager.HeapSize=0x0000
ProjectManager.StackSize=0x500
ProjectManager.TargetToolchain=EWARM V9.60
RCC.ADCFreq_Value=16000000
RCC.AHBCLKDivider=RCC_SYSCLK_DIV1
RCC.AHBFreq_Value=16000000
RCC.APB1Freq_Value=16000000
RCC.APB1TimFreq_Value=16000000
RCC.APB2CLKDivider=RCC_HCLK_DIV2
RCC.APB2Freq_Value=8000000
RCC.APB2TimFreq_Value=16000000
RCC.CortexFreq_Value=2000000
RCC.HCLKFreq_Value=16000000
RCC.HSE_VALUE=32000000
RCC.HSI_VALUE=16000000
RCC.LSE_VALUE=32768
RCC.LSI1_VALUE=32000
RCC.LSI2_VALUE=32000
RCC.PLLFRACN=0
RCC.PLLN=8
RCC.PREFETCH_ENABLE=1
RCC.PWR_Regulator_Voltage_Scale=PWR_REGULATOR_VOLTAGE_SCALE1
RCC.RCC_MCODiv=RCC_MCODIV_16
RCC.RSTClockSelectionVirtual=RCC_RADIOSTCLKSOURCE_LSE
RCC.RTCClockSelection=RCC_RTCCLKSOURCE_LSE
RCC.SYSCLKFreq_VALUE=16000000
RCC.SYSCLKSourceVirtual=RCC_SYSCLKSOURCE_HSI
RCC.USART1CLockSelectionVirtual=RCC_USART1CLKSOURCE_HSI
RCC.VCOOutputFreq_Value=128000000
VP_CORTEX_M33_NS_VS_Hclk.Mode=Hclk_Mode
VP_ICACHE_VS_ICACHE.Mode=DirectMappedCache
VP_PWR_VS_SECSignals.Mode=Security/Privilege
board=custom

// file: Core/Src/main.c
/* USER CODE BEGIN Header */
/**
  ******************************************************************************
  * @file           : main.c
  * @brief          : Main program body
  ******************************************************************************
  * @attention
  *
  * Copyright (c) 2026 STMicroelectronics.
  * All rights reserved.
  *
  * This software is licensed under terms that can be found in the LICENSE file
  * in the root directory of this software component.
  * If no LICENSE file comes with this software, it is provided AS-IS.
  *
  ******************************************************************************
  */
/* USER CODE END Header */
#include "main.h"

/* USER CODE BEGIN PTD */
typedef void (*fct_t)(void);

/* USER CODE END PTD */

/* USER CODE BEGIN PD */

/* Magic Keyword address offset, defined by the TAG_OTA_START address offset defined in the generated .map file of BLE Application with OTA  */
#define KEYWORD_ADDRESS_OFFSET              (0x150)

/* Define the NVM size in sector */
#define CFG_NVM_NB_SECTORS                  (4)
/* Define the User Data size in sector */
#define CFG_USER_DATA_NB_SECTORS            (2)
/* Define the start address where the application shall be located */
#define CFG_ACTIVE_SLOT_START_SECTOR_INDEX  (6)

/* Define mapping of OTA messages in SRAM */
#define CFG_OTA_REBOOT_VAL_MSG              (*(uint8_t*)(SRAM1_BASE+0))
#define CFG_OTA_START_SECTOR_IDX_VAL_MSG    (*(uint8_t*)(SRAM1_BASE+1))

/* Size in Page of Download and Active slots */
#define DOWNLOAD_ACTIVE_NB_SECTORS          ((FLASH_SIZE / FLASH_PAGE_SIZE) - CFG_NVM_NB_SECTORS - CFG_USER_DATA_NB_SECTORS)
/* Start address where the User Data shall be located */
#define USER_CFG_SLOT_START_SECTOR_INDEX    ((FLASH_SIZE / FLASH_PAGE_SIZE) - CFG_NVM_NB_SECTORS - CFG_USER_DATA_NB_SECTORS)
/* Size in Page of Download or active slot */
#define APP_SLOT_PAGE_SIZE                  ((DOWNLOAD_ACTIVE_NB_SECTORS - CFG_ACTIVE_SLOT_START_SECTOR_INDEX) / 2)
/* Define the start address where the NEW application shall be downloaded */
#define DOWNLOAD_SLOT_START_SECTOR_INDEX    (APP_SLOT_PAGE_SIZE + CFG_ACTIVE_SLOT_START_SECTOR_INDEX)

/* Define list of reboot reason */
#define REBOOT_ON_FW_APP                    (0x00)
#define REBOOT_ON_APP_INSTALL_MNGR          (0x01)

/* USER CODE END PD */

void SystemClock_Config(void);
/* USER CODE BEGIN PFP */
static void BootModeCheck( void );
static uint8_t CheckFwAppValidity( uint8_t page_idx );
void JumpFwApp( void );
static void DeleteSlot( uint8_t page_idx );
static void MoveToActiveSlot( uint8_t page_idx );
static void JumpSelectionOnPowerUp( void );

/* USER CODE END PFP */

int main(void)
{

  /* MCU Configuration--------------------------------------------------------*/

  /* Reset of all peripherals, Initializes the Flash interface and the Systick. */
  HAL_Init();

  /* Enable PWR clock interface */

  LL_AHB4_GRP1_EnableClock(LL_AHB4_GRP1_PERIPH_PWR);

  /* Configure the system clock */
  SystemClock_Config();

  /* Initialize all configured peripherals */
  MX_GPIO_Init();
  /* USER CODE BEGIN 2 */
  BootModeCheck();

  /* USER CODE END 2 */

  /* Infinite loop */
  while (1)
  {

  }
}

void SystemClock_Config(void)
{
  LL_FLASH_SetLatency(LL_FLASH_LATENCY_0);
  while(LL_FLASH_GetLatency()!= LL_FLASH_LATENCY_0)
  {
  }

  LL_PWR_SetRegulVoltageScaling(LL_PWR_REGU_VOLTAGE_SCALE1);
  LL_RCC_HSI_Enable();

   /* Wait till HSI is ready */
  while(LL_RCC_HSI_IsReady() != 1)
  {
  }

  LL_RCC_HSI_SetCalibTrimming(16);
  LL_RCC_SetSysClkSource(LL_RCC_SYS_CLKSOURCE_HSI);

   /* Wait till System clock is ready */
  while(LL_RCC_GetSysClkSource() != LL_RCC_SYS_CLKSOURCE_STATUS_HSI)
  {
  }

  LL_RCC_SetAHBPrescaler(LL_RCC_SYSCLK_DIV_1);
  LL_RCC_SetAHB5Divider(LL_RCC_AHB5_DIVIDER_1);
  LL_RCC_SetAPB1Prescaler(LL_RCC_APB1_DIV_1);
  LL_RCC_SetAPB2Prescaler(LL_RCC_APB2_DIV_2);
  LL_RCC_SetAPB7Prescaler(LL_RCC_APB7_DIV_1);
  LL_SetSystemCoreClock(16000000);

   /* Update the time base */
  if (HAL_InitTick (TICK_INT_PRIORITY) != HAL_OK)
  {
    Error_Handler();
  }
}

void MX_GPIO_Init(void)
{

  /* GPIO Ports Clock Enable */

}

/* USER CODE BEGIN 4 */

/* Overwrite HAL Tick functions to not use sysTick start sysTick */
HAL_StatusTypeDef HAL_InitTick(uint32_t TickPriority)
{
  return HAL_OK;
}

/**
 * Check the Boot mode request
 * Depending on the result, the CPU may either jump to an existing application in the user flash
 * or keep on running the code to start the OTA loader
 */
static void BootModeCheck( void )
{
  if(LL_RCC_IsActiveFlag_SFTRST( ) || LL_RCC_IsActiveFlag_OBLRST( ))
  {
    /**
     * The SRAM1 content is kept on Software Reset.
     * First address of the SRAM1 indicates which kind of action has been requested
     */

    /**
     * Check Boot Mode from SRAM1
     */
    if((CFG_OTA_REBOOT_VAL_MSG == REBOOT_ON_FW_APP) && (CheckFwAppValidity(CFG_ACTIVE_SLOT_START_SECTOR_INDEX) != 0))
    {
      uint8_t download_slot_start_sector = CFG_OTA_START_SECTOR_IDX_VAL_MSG;

      if((download_slot_start_sector >= (FLASH_SIZE / FLASH_PAGE_SIZE)) ||
         ((download_slot_start_sector < CFG_ACTIVE_SLOT_START_SECTOR_INDEX)))
      {
        /* CFG_OTA_START_SECTOR_IDX_VAL_MSG not correctly initialized */
        download_slot_start_sector = DOWNLOAD_SLOT_START_SECTOR_INDEX;
        CFG_OTA_START_SECTOR_IDX_VAL_MSG = DOWNLOAD_SLOT_START_SECTOR_INDEX;
      }

      if(CheckFwAppValidity(download_slot_start_sector) != 0)
      {
        /**
         * The user has requested to start on the firmware application and it has been checked
         * a valid application is ready in the download slot
         */
        DeleteSlot( CFG_ACTIVE_SLOT_START_SECTOR_INDEX ); /* Erase active slot */
        MoveToActiveSlot(download_slot_start_sector); /* Move download slot to active slot */
        if(CheckFwAppValidity(CFG_ACTIVE_SLOT_START_SECTOR_INDEX) != 0)
        {
          DeleteSlot( DOWNLOAD_SLOT_START_SECTOR_INDEX ); /* Erase download slot */
        }
      }

      /**
       * Jump now on the application
       */
      JumpFwApp();
    }
    else if((CFG_OTA_REBOOT_VAL_MSG == REBOOT_ON_FW_APP) && (CheckFwAppValidity(CFG_ACTIVE_SLOT_START_SECTOR_INDEX) == 0))
    {
      /**
       * The user has requested to start on the firmware application but there is no valid application
       * Erase all sectors specified by byte1 and byte1 in SRAM1 to download a new App.
       */
      CFG_OTA_REBOOT_VAL_MSG = REBOOT_ON_APP_INSTALL_MNGR; /* Request to reboot on Application Install Manager */
      CFG_OTA_START_SECTOR_IDX_VAL_MSG = CFG_ACTIVE_SLOT_START_SECTOR_INDEX;
    }
    else if(CFG_OTA_REBOOT_VAL_MSG == REBOOT_ON_APP_INSTALL_MNGR)
    {
      /**
       * It has been requested to reboot on App Install Manager application to download data
       * Erase download slot to download a new App.
       */
      DeleteSlot( DOWNLOAD_SLOT_START_SECTOR_INDEX ); /* Erase download slot */
      JumpFwApp();                                    /* Jump to OTA application */
    }
    else
    {
      /**
       * There should be no use case to be there because the device already starts from power up
       * and the SRAM1 is then filled with the value define by the user
       * However, it could be that a reset occurs just after a power up and in that case,
       * App Install Manager will be running but the sectors to download a new App may not be erased
       */
      JumpSelectionOnPowerUp( );
    }
  }
  else
  {
    /**
     * On Power up, the content of SRAM1 is random
     * The only thing that could be done is to jump on either the firmware application
     * or the App Install Manager application
     */
    JumpSelectionOnPowerUp( );
  }

  return;
}

/**
 * Return 0 if FW App not valid
 * Return 1 if Fw App valid
 */
static uint8_t CheckFwAppValidity( uint8_t page_idx )
{
  uint8_t status;
  uint32_t magic_keyword_address;
  uint32_t last_user_flash_address;

  magic_keyword_address = *(uint32_t*)(FLASH_BASE + (page_idx * FLASH_PAGE_SIZE + KEYWORD_ADDRESS_OFFSET));

  if(page_idx != CFG_ACTIVE_SLOT_START_SECTOR_INDEX)
  {
    /* magic_keyword_address is in the download slot = active slot + APP_SLOT_PAGE_SIZE */
    magic_keyword_address += ((page_idx - CFG_ACTIVE_SLOT_START_SECTOR_INDEX) * FLASH_PAGE_SIZE);
  }
  last_user_flash_address = (FLASH_SIZE + FLASH_BASE) - 4;
  if( (magic_keyword_address < FLASH_BASE) || (magic_keyword_address > last_user_flash_address) )
  {
    /**
     * The address is not valid
     */
    status = 0;
  }
  else
  {
    if( (*(uint32_t*)magic_keyword_address) != 0x94448A29  )
    {
      /**
       * A firmware update procedure did not complete
       */
      status = 0;
    }
    else
    {
      /**
       * The firmware application is available
       */
      status = 1;
    }
  }

  return status;
}

/**
 * Jump to existing FW App in flash
 * It never returns
 */
void JumpFwApp( void )
{
  fct_t app_reset_handler;

  SCB->VTOR = FLASH_BASE + (CFG_ACTIVE_SLOT_START_SECTOR_INDEX * FLASH_PAGE_SIZE);
  __set_MSP(*(uint32_t*)(FLASH_BASE + (CFG_ACTIVE_SLOT_START_SECTOR_INDEX * FLASH_PAGE_SIZE)));
  app_reset_handler = (fct_t)(*(uint32_t*)(FLASH_BASE + (CFG_ACTIVE_SLOT_START_SECTOR_INDEX * FLASH_PAGE_SIZE) + 4));
  app_reset_handler();

  /**
   * app_reset_handler() never returns.
   * However, if for any reason a PUSH instruction is added at the entry of  JumpFwApp(),
   * we need to make sure the POP instruction is not there before app_reset_handler() is called
   * The way to ensure this is to add a dummy code after app_reset_handler() is called
   * This prevents app_reset_handler() to be the last code in the function.
   */
  __WFI();

  return;
}

/**
 * Erase active or download slot
 */
static void DeleteSlot( uint8_t page_idx )
{

  /**
   * The number of sectors to erase is read from SRAM1.
   * It shall be checked whether the number of sectors to erase does not overlap on the secured Flash
   * The limit can be read from the SFSA option byte which provides the first secured sector address.
   */

  uint32_t last_page_idx = page_idx + APP_SLOT_PAGE_SIZE - 1;
  FLASH_EraseInitTypeDef p_erase_init;
  uint32_t page_error;
  uint32_t NbrOfPageToBeErased = (uint32_t)APP_SLOT_PAGE_SIZE;

  if(page_idx < CFG_ACTIVE_SLOT_START_SECTOR_INDEX)
  {
    /**
     * Something has been wrong as there is no case we should delete the BLE_BootMngr application
     * Reboot on the active firmware application
     */
    CFG_OTA_REBOOT_VAL_MSG = REBOOT_ON_FW_APP;
    NVIC_SystemReset(); /* it waits until reset */
  }

  if ((page_idx + NbrOfPageToBeErased - 1) > last_page_idx)
  {
    NbrOfPageToBeErased = last_page_idx - page_idx + 1;
  }

  p_erase_init.TypeErase = FLASH_TYPEERASE_PAGES;
  p_erase_init.NbPages = NbrOfPageToBeErased;
  p_erase_init.Page = (uint32_t)(page_idx & (FLASH_PAGE_NB - 1u));

#if defined(FLASH_DBANK_SUPPORT)
  if ((FLASH_PAGE_NB & page_idx) ^ (1u & READ_BIT (FLASH->OPTR, FLASH_OPTR_SWAP_BANK_Msk)))
  {
    p_erase_init.Banks = FLASH_BANK_2;
  }
  else
  {
    p_erase_init.Banks = FLASH_BANK_1;
  }
#endif

  __HAL_FLASH_CLEAR_FLAG(FLASH_FLAG_ALL_ERRORS); /* Clear all Flash flags before write operation*/

  HAL_FLASH_Unlock();

  HAL_FLASHEx_Erase(&p_erase_init, &page_error);

  HAL_FLASH_Lock();

  return;
}

/**
 * Move download slot to active slot
 */
static void MoveToActiveSlot( uint8_t page_idx )
{
  uint32_t dwn_addr, act_addr, last_addr;

  /**
   * Write in Flash the data received in the BLE packet
   */
  dwn_addr = FLASH_BASE + (page_idx * FLASH_PAGE_SIZE);
  act_addr = FLASH_BASE + (CFG_ACTIVE_SLOT_START_SECTOR_INDEX * FLASH_PAGE_SIZE);
  /* Last address of the new binary relative to the start address in the active slot */
  last_addr = *(uint32_t*)(dwn_addr + KEYWORD_ADDRESS_OFFSET);
  last_addr &= 0xFFFFFFF8;  /* Align on 8-byte boundary */

  /**
   * The flash is written by bunch of 8 bytes
   * Data are written in flash as long as there are at least 8 bytes
   */
  while( act_addr <= last_addr )
  {
    HAL_StatusTypeDef status = HAL_ERROR;

    __HAL_FLASH_CLEAR_FLAG(FLASH_FLAG_ALL_ERRORS); /* Clear all Flash flags before write operation*/

    HAL_FLASH_Unlock();

    while(status != HAL_OK)
      status = HAL_FLASH_Program(FLASH_TYPEPROGRAM_DOUBLEWORD,
                                 act_addr,
                                 dwn_addr);

    HAL_FLASH_Lock();

    if((*(uint64_t*)(act_addr) == *(uint64_t*)(dwn_addr)))
    {
      act_addr += 8;
      dwn_addr += 8;
    }
  }
}

static void JumpSelectionOnPowerUp( void )
{
  /**
   * Check if there is a FW App
   */
  if(CheckFwAppValidity(CFG_ACTIVE_SLOT_START_SECTOR_INDEX) != 0)
  {
    /**
     * The SRAM1 is random
     * Initialize SRAM1 to indicate we requested to reboot of firmware application
     */
    CFG_OTA_REBOOT_VAL_MSG = REBOOT_ON_FW_APP;

    /**
     * A valid application is available
     * Jump now on the application
     */
    JumpFwApp();
  }
  else
  {
    /**
     * The SRAM1 is random
     * Initialize SRAM1 to indicate we requested to reboot of BLE_Ota application
     */
    CFG_OTA_REBOOT_VAL_MSG = REBOOT_ON_APP_INSTALL_MNGR;

    /**
     * There is no valid application available
     * Erase all sectors specified by byte1 and byte1 in SRAM1 to download a new App.
     */
    CFG_OTA_START_SECTOR_IDX_VAL_MSG = CFG_ACTIVE_SLOT_START_SECTOR_INDEX;
  }
  return;
}

/* USER CODE END 4 */

void Error_Handler(void)
{
  __disable_irq();
  while (1)
  {
  }
}
