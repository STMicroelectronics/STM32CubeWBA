# file: Sequencer_task_waitevent.ioc
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CORTEX_M33_NS.userName=CORTEX_M33
Mcu.Family=STM32WBA
Mcu.Name=STM32WBA52CGUx
Mcu.Package=UFQFPN48
NVIC.PriorityGroup=NVIC_PRIORITYGROUP_4
ProjectManager.HeapSize=0x200
ProjectManager.StackSize=0x400
ProjectManager.TargetToolchain=EWARM V8
RCC.ADCFreq_Value=16000000
RCC.AHBFreq_Value=16000000
RCC.APB1Freq_Value=16000000
RCC.APB1TimFreq_Value=16000000
RCC.APB2Freq_Value=16000000
RCC.APB2TimFreq_Value=16000000
RCC.CortexFreq_Value=16000000
RCC.HCLKFreq_Value=16000000
RCC.HSE_VALUE=16000000
RCC.HSI_VALUE=16000000
RCC.LSE_VALUE=32768
RCC.SYSCLKFreq_VALUE=16000000
RCC.VCOOutputFreq_Value=2064000000
VP_ICACHE_VS_ICACHE.Mode=DirectMappedCache
VP_PWR_VS_SECSignals.Mode=Security/Privilege
board=custom

// file: Src/main.c
/* USER CODE BEGIN Header */
/**
  ******************************************************************************
  * @file    Applications/Sequencer/Sequencer_task_waitevent/Src/main.c
  * @author  MCD Application Team
  * @brief   This example describes how the the sequencer manage the task prio.
  ******************************************************************************
  * @attention
  *
  * Copyright (c) 2022 STMicroelectronics.
  * All rights reserved.
  *
  * This software is licensed under terms that can be found in the LICENSE file
  * in the root directory of this software component.
  * If no LICENSE file comes with this software, it is provided AS-IS.
  *
  ******************************************************************************
  */
/* USER CODE END Header */
#include "main.h"

/* USER CODE BEGIN Includes */
#include "stm32wbaxx_nucleo.h"
/* sequencer include */
#include "stm32_seq.h"
/* USER CODE END Includes */

/* USER CODE BEGIN PD */
#define ALLTASKS 0xFFFFFFFFU
/* Task ID definition (a task is represented by only one bit at 1 on the 32-bit value) */
#define TASK0    1U << 0U
#define TASK1    1U << 1U
#define TASK2    1U << 2U

#define PRIO_HIGH   0U
#define PRIO_MEDIUM 1U
#define PRIO_LOW    2U

#define TASK1_FREQ       1000U
#define TASK2_FREQ        125U

#define TASK_TOGGLE_TIME 5000U
/* Event definition (an event is represented by only one bit at 1 on the 32-bit value) */
#define EVENT0   1U << 0U
/* USER CODE END PD */

void SystemClock_Config(void);
static void MX_ICACHE_Init(void);
/* USER CODE BEGIN PFP */
/* task function prototype */
void function_Task0( void );
void function_Task1( void );
void function_Task2( void );
/* USER CODE END PFP */

int main(void)
{

  /* MCU Configuration--------------------------------------------------------*/

  /* Reset of all peripherals, Initializes the Flash interface and the Systick. */
  HAL_Init();

  /* Configure the system clock */
  SystemClock_Config();

  /* Initialize all configured peripherals */
  MX_ICACHE_Init();

  /* Infinite loop */
  /* USER CODE BEGIN WHILE */
  BSP_LED_Init(LD1);
  /* sequencer initialization */
  UTIL_SEQ_Init();
  /* sequencer task registration */
  UTIL_SEQ_RegTask(TASK0, 0, function_Task0);
  UTIL_SEQ_RegTask(TASK1, 0, function_Task1);
  UTIL_SEQ_RegTask(TASK2, 0, function_Task2);
  UTIL_SEQ_SetTask(TASK0, PRIO_LOW);
  while (1)
  {
    /* USER CODE END WHILE */

    /* USER CODE BEGIN 3 */
    /* run the sequencer */
    UTIL_SEQ_Run(ALLTASKS);
  }
  /* USER CODE END 3 */
}

void SystemClock_Config(void)
{
  RCC_OscInitTypeDef RCC_OscInitStruct = {0};
  RCC_ClkInitTypeDef RCC_ClkInitStruct = {0};

  /** Configure the main internal regulator output voltage
  */
  if (HAL_PWREx_ControlVoltageScaling(PWR_REGULATOR_VOLTAGE_SCALE2) != HAL_OK)
  {
    Error_Handler();
  }

  /** Initializes the CPU, AHB and APB busses clocks
  */
  RCC_OscInitStruct.OscillatorType = RCC_OSCILLATORTYPE_HSI;
  RCC_OscInitStruct.HSIState = RCC_HSI_ON;
  RCC_OscInitStruct.HSICalibrationValue = RCC_HSICALIBRATION_DEFAULT;
  RCC_OscInitStruct.PLL1.PLLState = RCC_PLL_NONE;
  if (HAL_RCC_OscConfig(&RCC_OscInitStruct) != HAL_OK)
  {
    Error_Handler();
  }

  /** Initializes the CPU, AHB and APB busses clocks
  */
  RCC_ClkInitStruct.ClockType = RCC_CLOCKTYPE_HCLK|RCC_CLOCKTYPE_SYSCLK
                              |RCC_CLOCKTYPE_PCLK1|RCC_CLOCKTYPE_PCLK2
                              |RCC_CLOCKTYPE_PCLK7|RCC_CLOCKTYPE_HCLK5;
  RCC_ClkInitStruct.SYSCLKSource = RCC_SYSCLKSOURCE_HSI;
  RCC_ClkInitStruct.AHBCLKDivider = RCC_SYSCLK_DIV1;
  RCC_ClkInitStruct.APB1CLKDivider = RCC_HCLK_DIV1;
  RCC_ClkInitStruct.APB2CLKDivider = RCC_HCLK_DIV1;
  RCC_ClkInitStruct.APB7CLKDivider = RCC_HCLK_DIV1;
  RCC_ClkInitStruct.AHB5_PLL1_CLKDivider = RCC_SYSCLK_PLL1_DIV1;
  RCC_ClkInitStruct.AHB5_HSEHSI_CLKDivider = RCC_SYSCLK_HSEHSI_DIV1;

  if (HAL_RCC_ClockConfig(&RCC_ClkInitStruct, FLASH_LATENCY_1) != HAL_OK)
  {
    Error_Handler();
  }
}

static void MX_ICACHE_Init(void)
{

  /** Enable instruction cache in 1-way (direct mapped cache)
  */
  if (HAL_ICACHE_ConfigAssociativityMode(ICACHE_1WAY) != HAL_OK)
  {
    Error_Handler();
  }
  if (HAL_ICACHE_Enable() != HAL_OK)
  {
    Error_Handler();
  }
}

/* USER CODE BEGIN 4 */
/* task0 function definition */
void function_Task0( void )
{
  HAL_GPIO_WritePin(LD1_GPIO_PORT, LD1_PIN, GPIO_PIN_RESET);
  HAL_Delay(2000);
  UTIL_SEQ_SetTask(TASK0, PRIO_LOW);
  UTIL_SEQ_SetTask(TASK1, PRIO_MEDIUM);
  UTIL_SEQ_SetTask(TASK2, PRIO_HIGH);
}
/* task1 function definition */
void function_Task1( void )
{
  uint32_t time_start = HAL_GetTick();
  do {
    HAL_GPIO_TogglePin(LD1_GPIO_PORT, LD1_PIN);
    HAL_Delay(TASK1_FREQ);
  } while(HAL_GetTick() - time_start < TASK_TOGGLE_TIME);
  UTIL_SEQ_SetEvt(EVENT0);
}

/* task2 function definition */
void function_Task2( void )
{
  uint32_t time_start;
  UTIL_SEQ_WaitEvt(EVENT0);
  time_start = HAL_GetTick();
  do {
    HAL_GPIO_TogglePin(LD1_GPIO_PORT, LD1_PIN);
    HAL_Delay(TASK2_FREQ);
  } while(HAL_GetTick() - time_start < TASK_TOGGLE_TIME);
}
/* USER CODE END 4 */

void Error_Handler(void)
{
  __disable_irq();
  while (1)
  {
  }
}
