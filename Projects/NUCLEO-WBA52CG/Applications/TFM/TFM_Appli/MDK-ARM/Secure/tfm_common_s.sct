#! armclang --target=arm-arm-none-eabi -march=armv8-m.main -E -xc

/*
 * Copyright (c) 2017-2019 Arm Limited. All rights reserved.
 *
 * Licensed under the Apache License, Version 2.0 (the "License");
 * you may not use this file except in compliance with the License.
 * You may obtain a copy of the License at
 *
 *     http://www.apache.org/licenses/LICENSE-2.0
 *
 * Unless required by applicable law or agreed to in writing, software
 * distributed under the License is distributed on an "AS IS" BASIS,
 * WITHOUT WARRANTIES OR CONDITIONS OF ANY KIND, either express or implied.
 * See the License for the specific language governing permissions and
 * limitations under the License.
 */

/*********** WARNING: This is an auto-generated file. Do not edit! ***********/

#include "region_defs.h"

LR_CODE S_CODE_START S_CODE_SIZE {

    /****  This initial section contains common code for secure binary */
    ER_TFM_CODE S_CODE_START ALIGN 8 {
        *.o (RESET +First)
        * (+RO)
     }

    /**** PSA RoT RO part (CODE + RODATA) start here */
    /*
     * This empty, zero long execution region is here to mark the start address
     * of PSA RoT code.
     */
    TFM_PSA_CODE_START +0 ALIGN 32 EMPTY 0x0 {
    }

    TFM_SP_ITS +0 ALIGN 32 {
        tfm_its_req_mngr.* (+RO)
        its*.* (+RO)
        *internal_trusted_storage.* (+RO)
        *(TFM_SP_ITS_ATTR_FN)
    }

#ifdef TFM_PARTITION_AUDIT_LOG
    TFM_SP_AUDIT_LOG +0 ALIGN 32 {
        *tfm_partition_audit.* (+RO)
        *(TFM_SP_AUDIT_LOG_ATTR_FN)
    }
#endif /* TFM_PARTITION_AUDIT_LOG */

    TFM_SP_CRYPTO +0 ALIGN 32 {
        crypto.* (+RO)
        platform.* (+RO)
        platform_util.* (+RO)
        *(TFM_SP_CRYPTO_ATTR_FN)
    }

#ifdef TFM_PARTITION_PLATFORM
    TFM_SP_PLATFORM +0 ALIGN 32 {
        platform_sp.* (+RO)
        tfm_plaform_system.* (+RO)
        *(TFM_SP_PLATFORM_ATTR_FN)
    }
#endif /* TFM_PARTITION_PLATFORM */

    TFM_SP_INITIAL_ATTESTATION +0 ALIGN 32 {
        *tfm_partition_attestation.* (+RO)
        *(TFM_SP_INITIAL_ATTESTATION_ATTR_FN)
    }

#ifdef TFM_PARTITION_TEST_CORE
    TFM_SP_CORE_TEST +0 ALIGN 32 {
        *tfm_ss_core_test.* (+RO)
        *(TFM_SP_CORE_TEST_ATTR_FN)
    }
#endif /* TFM_PARTITION_TEST_CORE */

#ifdef TFM_PARTITION_TEST_SECURE_SERVICES
    TFM_SP_SECURE_TEST_PARTITION +0 ALIGN 32 {
        *tfm_secure_client_service.* (+RO)
        *test_framework* (+RO)
        *uart_stdout.* (+RO)
        *Driver_USART.* (+RO)
        *arm_uart_drv.* (+RO)
        *uart_pl011_drv.* (+RO)
        *uart_cmsdk_drv* (+RO)
        *secure_suites.* (+RO)
        *attestation_s_interface_testsuite.* (+RO)
        *(TFM_SP_SECURE_TEST_PARTITION_ATTR_FN)
    }
#endif /* TFM_PARTITION_TEST_SECURE_SERVICES */

#ifdef TFM_PARTITION_TEST_CORE_IPC
    TFM_SP_IPC_SERVICE_TEST +0 ALIGN 32 {
        *ipc_service_test.* (+RO)
        *(TFM_SP_IPC_SERVICE_TEST_ATTR_FN)
    }
#endif /* TFM_PARTITION_TEST_CORE_IPC */

#ifdef TFM_PARTITION_TEST_PS
    TFM_SP_PS_TEST +0 ALIGN 32 {
        *tfm_ps_test_service.* (+RO)
        *(TFM_SP_PS_TEST_ATTR_FN)
    }
#endif /* TFM_PARTITION_TEST_PS */

    /*
     * This empty, zero long execution region is here to mark the end address
     * of PSA RoT code.
     */
    TFM_PSA_CODE_END +0 ALIGN 32 EMPTY 0x0 {
    }

    TFM_UNPRIV_CODE  AlignExpr(+0, GTZC_FLASH_ALIGN) FIXED{
        tfm_spm_services.o (+RO)
        tfm_*_secure_api.o (+RO)
        crt_*.o (+RO)
        service_api.o (+RO)
        sprt*.o (+RO)
        psa_client.o (+RO)
        psa_service.o (+RO)
        psa_lifecycle.o (+RO)
        stm32wbaxx_hal*.o (+RO)
        tick.o (+RO)
        tfm_log_raw.o (+RO)
        low_level_com.o (+RO)
        uart_stdout.o (+RO)
        *(SFN)
        *armlib*
    }

    TFM_SP_PS +0 ALIGN 32 {
        ps*.* (+RO)
        *protected_storage*.* (+RO)
        tfm_ps_req*.* (+RO)
        *(TFM_SP_PS_ATTR_FN)
    }

    /**** APPLICATION RoT RO part (CODE + RODATA) start here */
    /*
     * This empty, zero long execution region is here to mark the start address
     * of APP RoT code.
     */
    TFM_APP_CODE_START +0 ALIGN 32 EMPTY 0x0 {
    }

#if defined (TFM_PARTITION_APP_ROT)
    TFM_APP_ROT +0 ALIGN 32 {
        *app_rot*.* (+RO)
        *(TFM_SP_APP_ROT_ATTR_FN)
    }
#endif /* TFM_PARTITION_APP_ROT */

#ifdef TFM_PARTITION_TEST_CORE
    TFM_SP_CORE_TEST_2 +0 ALIGN 32 {
        *tfm_ss_core_test_2.* (+RO)
        *(TFM_SP_CORE_TEST_2_ATTR_FN)
    }
#endif /* TFM_PARTITION_TEST_CORE */

#ifdef TFM_PARTITION_TEST_CORE_IPC
    TFM_SP_IPC_CLIENT_TEST +0 ALIGN 32 {
        *ipc_client_test.* (+RO)
        *(TFM_SP_IPC_CLIENT_TEST_ATTR_FN)
    }
#endif /* TFM_PARTITION_TEST_CORE_IPC */

#ifdef TFM_ENABLE_IRQ_TEST
    TFM_IRQ_TEST_1 +0 ALIGN 32 {
        *tfm_irq_test_service_1.* (+RO)
        *timer_cmsdk* (+RO)
        *(TFM_IRQ_TEST_1_ATTR_FN)
    }
#endif /* TFM_ENABLE_IRQ_TEST */

#ifdef TFM_PARTITION_TEST_SECURE_SERVICES
    TFM_SP_SECURE_CLIENT_2 +0 ALIGN 32 {
        *tfm_secure_client_2.* (+RO)
        *(TFM_SP_SECURE_CLIENT_2_ATTR_FN)
    }
#endif /* TFM_PARTITION_TEST_SECURE_SERVICES */

    /*
     * This empty, zero long execution region is here to mark the end address
     * of APP RoT code.
     */
    TFM_APP_CODE_END +0 ALIGN 32 EMPTY 0x0 {
    }

    /**** PSA RoT DATA start here */

    /**** Base address of secure data area */
    TFM_SECURE_DATA_START (S_DATA_START + BOOT_SHARED_DATA_SIZE) ALIGN 32 EMPTY 0x0 {
    }

    ARM_LIB_HEAP +0 ALIGN 8 EMPTY S_HEAP_SIZE {
    }

    ER_TFM_DATA +0 ALIGN 8 {
        * (+RW +ZI)
    }

    TFM_SP_ITS_DATA +0 ALIGN 32 {
        *internal_trusted_storage.* (+RW +ZI)
        its*.* (+RW +ZI)
        tfm_its_req_mngr.* (+RW +ZI)
        *(TFM_SP_ITS_ATTR_RW)
        *(TFM_SP_ITS_ATTR_ZI)
    }

#ifdef TFM_PARTITION_AUDIT_LOG
    TFM_SP_AUDIT_LOG_DATA +0 ALIGN 32 {
        *tfm_partition_audit.* (+RW +ZI)
        *(TFM_SP_AUDIT_LOG_ATTR_RW)
        *(TFM_SP_AUDIT_LOG_ATTR_ZI)
    }
#endif /* TFM_PARTITION_AUDIT_LOG */

    TFM_SP_CRYPTO_DATA +0 ALIGN 32 {
        crypto.* (+RW +ZI)
        intermediate_tfm_crypto.* (+RW +ZI)
        *(TFM_SP_CRYPTO_ATTR_RW)
        *(TFM_SP_CRYPTO_ATTR_ZI)
    }

    TFM_SP_INITIAL_ATTESTATION_DATA +0 ALIGN 32 {
        *tfm_partition_attestation.* (+RW +ZI)
        *UsefulBuff.* (+RW +ZI)
        *(TFM_SP_INITIAL_ATTESTATION_ATTR_RW)
        *(TFM_SP_INITIAL_ATTESTATION_ATTR_ZI)
    }

#ifdef TFM_PARTITION_TEST_CORE
    TFM_SP_CORE_TEST_DATA +0 ALIGN 32 {
        *tfm_ss_core_test.* (+RW +ZI)
        *(TFM_SP_CORE_TEST_ATTR_RW)
        *(TFM_SP_CORE_TEST_ATTR_ZI)
    }
#endif /* TFM_PARTITION_TEST_CORE */

#ifdef TFM_PARTITION_TEST_SECURE_SERVICES
    TFM_SP_SECURE_TEST_PARTITION_DATA +0 ALIGN 32 {
        *tfm_secure_client_service.* (+RW +ZI)
        *test_framework* (+RW +ZI)
        *uart_stdout.* (+RW +ZI)
        *Driver_USART.* (+RW +ZI)
        *arm_uart_drv.* (+RW +ZI)
        *uart_pl011_drv.* (+RW +ZI)
        *uart_cmsdk_drv* (+RW +ZI)
        *secure_suites.* (+RW +ZI)
        *attestation_s_interface_testsuite.* (+RW +ZI)
        *(TFM_SP_SECURE_TEST_PARTITION_ATTR_RW)
        *(TFM_SP_SECURE_TEST_PARTITION_ATTR_ZI)
    }
#endif /* TFM_PARTITION_TEST_SECURE_SERVICES */

#ifdef TFM_PARTITION_TEST_CORE_IPC
    TFM_SP_IPC_SERVICE_TEST_DATA +0 ALIGN 32 {
        *ipc_service_test.* (+RW +ZI)
        *(TFM_SP_IPC_SERVICE_TEST_ATTR_RW)
        *(TFM_SP_IPC_SERVICE_TEST_ATTR_ZI)
    }
#endif /* TFM_PARTITION_TEST_CORE_IPC */

#ifdef TFM_PARTITION_TEST_PS
    TFM_SP_PS_TEST_DATA +0 ALIGN 32 {
        *sst*.* (+RW +ZI)
        tfm_protected_storage*.* (+RW +ZI)
        *(TFM_SP_PS_TEST_ATTR_RW)
        *(TFM_SP_PS_TEST_ATTR_ZI)
    }
#endif /* TFM_PARTITION_TEST_PS */

    /* MSP */
    ARM_LIB_STACK_MSP +0 ALIGN 32 OVERLAY EMPTY S_MSP_STACK_SIZE {
    }

    TFM_SP_PLATFORM_DATA +0 ALIGN 32 {
        platform_sp.* (+RW +ZI)
        tfm_platform_system.* (+RW +ZI)
        tfm_platform.* (+RW +ZI)
        *tfm_platform.* (+RW +ZI)
        *(TFM_SP_PLATFORM_ATTR_RW)
        *(TFM_SP_PLATFORM_ATTR_ZI)
    }

#ifdef TFM_PARTITION_FIRMWARE_UPDATE
    TFM_SP_FIRMWARE_UPDATE +0 ALIGN 32 {
        tfm_mcuboot_fwu.* (+RW +ZI)
        *tfm_firmware_update.* (+RW +ZI)
        tfm_fwu*.* (+RW +ZI)
    }
#endif /* TFM_PARTITION_FIRMWARE_UPDATE */

    /*
     * This empty, zero long execution region is here to mark the start address
     * of PSA RoT RW and Stack.
     */
    TFM_PSA_RW_STACK_END +0 ALIGN GTZC_RAM_ALIGN EMPTY 0x0 {
    }

      /* PSP */
    ARM_LIB_STACK  +0 ALIGN 32 EMPTY S_PSP_STACK_SIZE {
    }

    TFM_UNPRIV_DATA +0  ALIGN 32 {
        tfm_spm_services.o (+RW +ZI)
        device_definition.o (+RW +ZI)
        stm32wbaxx_hal*.o (+RW +ZI)
        tick.o (+RW +ZI)
    }

	/**** APP RoT DATA start here */
#if defined (TFM_PARTITION_APP_ROT)
    TFM_APP_ROT_DATA +0  ALIGN 32 {
        *app_rot*.* (+RW +ZI)
    }
#endif /* TFM_PARTITION_APP_ROT */

    TFM_SP_PS_DATA +0  ALIGN 32 {
        object ps*.* (+RW +ZI)
        object *protected_storage*.* (+RW +ZI)
        tfm_ps_req*.* (+RW +ZI)
    }

#ifdef TFM_PARTITION_TEST_CORE
    TFM_SP_CORE_TEST_2_DATA +0 ALIGN 32 {
        *tfm_ss_core_test_2.* (+RW +ZI)
        *(TFM_SP_CORE_TEST_2_ATTR_RW)
        *(TFM_SP_CORE_TEST_2_ATTR_ZI)
    }
#endif /* TFM_PARTITION_TEST_CORE */

#ifdef TFM_PARTITION_TEST_CORE_IPC
    TFM_SP_IPC_CLIENT_TEST_DATA +0 ALIGN 32 {
        *ipc_client_test.* (+RW +ZI)
        *(TFM_SP_IPC_CLIENT_TEST_ATTR_RW)
        *(TFM_SP_IPC_CLIENT_TEST_ATTR_ZI)
    }
#endif /* TFM_PARTITION_TEST_CORE_IPC */

#ifdef TFM_ENABLE_IRQ_TEST
    TFM_IRQ_TEST_1_DATA +0 ALIGN 32 {
        *tfm_irq_test_service_1.* (+RW +ZI)
        *timer_cmsdk* (+RW +ZI)
        *(TFM_IRQ_TEST_1_ATTR_RW)
        *(TFM_IRQ_TEST_1_ATTR_ZI)
    }
#endif /* TFM_ENABLE_IRQ_TEST */

#ifdef TFM_PARTITION_TEST_SECURE_SERVICES
    TFM_SP_SECURE_CLIENT_2_DATA +0 ALIGN 32 {
        *tfm_secure_client_2.* (+RW +ZI)
    }
#endif /* TFM_PARTITION_TEST_SECURE_SERVICES */
   /*
     * This empty, zero long execution region is here to mark the end address
     * of APP RoT RW and Stack.
     */
     TFM_APP_RW_STACK_END +0  ALIGN GTZC_RAM_ALIGN  EMPTY 0x0 {
    }

    /* This empty, zero long execution region is here to mark the limit address
     * of the last execution region that is allocated in SRAM.
     */
    SRAM_WATERMARK +0 EMPTY 0x0 {
    }

    /* Make sure that the sections allocated in the SRAM does not exceed the
     * size of the SRAM available.
     */
    ScatterAssert(ImageLimit(SRAM_WATERMARK) <= S_DATA_START + S_DATA_SIZE)
}



LR_VENEER CMSE_VENEER_REGION_START {
    /*
     * Place the CMSE Veneers (containing the SG instruction) in a separate
     * 32 bytes aligned region so that the SAU can be programmed to
     * just set this region as Non-Secure Callable.
     */
    ER_CODE_CMSE_VENEER CMSE_VENEER_REGION_START CMSE_VENEER_REGION_SIZE {
        *(Veneer$$CMSE)
    }
}


LR_NS_PARTITION NS_PARTITION_START {
    /* Reserved place for NS application.
     * No code will be placed here, just address of this region is used in the
     * secure code to configure certain HW components. This generates an empty
     * execution region description warning during linking.
     */
    ER_NS_PARTITION NS_PARTITION_START UNINIT NS_PARTITION_SIZE {
    }
}

#ifdef BL2
    /* Reserved place for new image in case of firmware upgrade.
     * No code will be placed here, just address of this region is used in the
     * secure code to configure certain HW components. This generates an empty
     * execution region description warning during linking.
     */
#if !defined(MCUBOOT_PRIMARY_ONLY)
LR_SECONDARY_PARTITION SECONDARY_PARTITION_START {
    ER_SECONDARY_PARTITION SECONDARY_PARTITION_START UNINIT SECONDARY_PARTITION_SIZE {
    }
}
#endif /* !defined(MCUBOOT_PRIMARY_ONLY) */
#endif /* BL2 */

