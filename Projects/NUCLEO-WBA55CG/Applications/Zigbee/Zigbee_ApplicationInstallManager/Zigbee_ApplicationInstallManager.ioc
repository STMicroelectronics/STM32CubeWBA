# file: Zigbee_ApplicationInstallManager.ioc
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CORTEX_M33_NS.userName=CORTEX_M33
Mcu.Family=STM32WBA
Mcu.Name=STM32WBA55CGUx
Mcu.Package=UFQFPN48
NVIC.PriorityGroup=NVIC_PRIORITYGROUP_4
NVIC.PKA_IRQn=true\:7\:0\:true\:false\:true\:true\:true\:true
OSC_IN.Mode=HSE-External-Oscillator
OSC_IN.Signal=RCC_OSC_IN
OSC_OUT.Mode=HSE-External-Oscillator
OSC_OUT.Signal=RCC_OSC_OUT
PA13\ (JTMS/SWDIO).Mode=Serial_Wire
PA13\ (JTMS/SWDIO).Signal=DEBUG_JTMS-SWDIO
PA14\ (JTCK/SWCLK).Mode=Serial_Wire
PA14\ (JTCK/SWCLK).Signal=DEBUG_JTCK-SWCLK
PWR.pwrPrivilege=PWR_PRIVILEGE_NO
ProjectManager.HeapSize=0x0000
ProjectManager.StackSize=0x500
ProjectManager.TargetToolchain=EWARM V9.60
RCC.ADCFreq_Value=16000000
RCC.AHBCLKDivider=RCC_SYSCLK_DIV1
RCC.AHBFreq_Value=16000000
RCC.APB1Freq_Value=16000000
RCC.APB1TimFreq_Value=16000000
RCC.APB2CLKDivider=RCC_HCLK_DIV2
RCC.APB2Freq_Value=8000000
RCC.APB2TimFreq_Value=16000000
RCC.CortexFreq_Value=2000000
RCC.HCLKFreq_Value=16000000
RCC.HSE_VALUE=32000000
RCC.HSI_VALUE=16000000
RCC.LSE_VALUE=32768
RCC.LSI1_VALUE=32000
RCC.LSI2_VALUE=32000
RCC.PLLFRACN=0
RCC.PLLN=8
RCC.PREFETCH_ENABLE=1
RCC.PWR_Regulator_Voltage_Scale=PWR_REGULATOR_VOLTAGE_SCALE2
RCC.RCC_MCODiv=RCC_MCODIV_16
RCC.RSTClockSelectionVirtual=RCC_RADIOSTCLKSOURCE_LSE
RCC.RTCClockSelection=RCC_RTCCLKSOURCE_LSE
RCC.SYSCLKFreq_VALUE=16000000
RCC.SYSCLKSourceVirtual=RCC_SYSCLKSOURCE_HSI
RCC.USART1CLockSelectionVirtual=RCC_USART1CLKSOURCE_HSI
RCC.VCOOutputFreq_Value=128000000
VP_CORTEX_M33_NS_VS_Hclk.Mode=Hclk_Mode
VP_ICACHE_VS_ICACHE.Mode=DirectMappedCache
VP_MEMORYMAP_VS_MEMORYMAP.Mode=CurAppReg
VP_PWR_VS_SECSignals.Mode=Security/Privilege
VP_AES_VS_AES.Mode=AES_Activate
VP_PKA_VS_PKA.Mode=PKA_Activate
board=NUCLEO-WBA55CG

// file: Core/Src/main.c
/* USER CODE BEGIN Header */
/**
  ******************************************************************************
  * @file           : main.c
  * @brief          : Main program body
  ******************************************************************************
  * @attention
  *
  * Copyright (c) 2022 STMicroelectronics.
  * All rights reserved.
  *
  * This software is licensed under terms that can be found in the LICENSE file
  * in the root directory of this software component.
  * If no LICENSE file comes with this software, it is provided AS-IS.
  *
  ******************************************************************************
  */
/* USER CODE END Header */
#include "main.h"

/* USER CODE BEGIN Includes */
#include "app_zigbee_ota_defines.h"

/* USER CODE END Includes */

/* USER CODE BEGIN PTD */
typedef void (* ResetHandler_t)(void);

/* USER CODE END PTD */

void SystemClock_Config(void);
/* USER CODE BEGIN PFP */
void     BootModeCheck                ( void );
uint32_t CheckFwAppValidity           ( void );
uint32_t CheckFwDownloadedValidity    ( void );

static void     MoveToActiveSlot      ( uint32_t lEndAppFwAddress );

static void     JumpSelectionOnPowerUp( void );
void            JumpFwApp             ( void );

/* USER CODE END PFP */

int main(void)
{

  /* MCU Configuration--------------------------------------------------------*/

  /* Reset of all peripherals, Initializes the Flash interface and the Systick. */
  HAL_Init();

  /* Enable PWR clock interface */

  LL_AHB4_GRP1_EnableClock(LL_AHB4_GRP1_PERIPH_PWR);

  /* Configure the system clock */
  SystemClock_Config();

  /* Initialize all configured peripherals */
  MX_GPIO_Init();
  /* USER CODE BEGIN 2 */
  BootModeCheck();

  /* USER CODE END 2 */

  /* Infinite loop */
  while (1)
  {

  }
}

void SystemClock_Config(void)
{
  LL_FLASH_SetLatency(LL_FLASH_LATENCY_1);
  while(LL_FLASH_GetLatency()!= LL_FLASH_LATENCY_1)
  {
  }

  LL_PWR_SetRegulVoltageScaling(LL_PWR_REGU_VOLTAGE_SCALE2);
  LL_RCC_HSI_Enable();

   /* Wait till HSI is ready */
  while(LL_RCC_HSI_IsReady() != 1)
  {
  }

  LL_RCC_HSI_SetCalibTrimming(16);
  LL_RCC_SetSysClkSource(LL_RCC_SYS_CLKSOURCE_HSI);

   /* Wait till System clock is ready */
  while(LL_RCC_GetSysClkSource() != LL_RCC_SYS_CLKSOURCE_STATUS_HSI)
  {
  }

  LL_RCC_SetAHBPrescaler(LL_RCC_SYSCLK_DIV_1);
  LL_RCC_SetAHB5Divider(LL_RCC_AHB5_DIVIDER_1);
  LL_RCC_SetAPB1Prescaler(LL_RCC_APB1_DIV_1);
  LL_RCC_SetAPB2Prescaler(LL_RCC_APB2_DIV_2);
  LL_RCC_SetAPB7Prescaler(LL_RCC_APB7_DIV_1);
  LL_SetSystemCoreClock(16000000);

   /* Update the time base */
  if (HAL_InitTick (TICK_INT_PRIORITY) != HAL_OK)
  {
    Error_Handler();
  }
}

void MX_GPIO_Init(void)
{

  /* GPIO Ports Clock Enable */
  __HAL_RCC_GPIOA_CLK_ENABLE();

}

/* USER CODE BEGIN 4 */

/**
 * Check the Boot mode request
 * Depending on the result, the CPU may either jump to an existing application in the user flash
 * or keep on running the code to start the OTA loader
 */
void BootModeCheck( void )
{
  uint32_t  lEndAppFwAddress = 0;

  if ( LL_RCC_IsActiveFlag_SFTRST( ) || LL_RCC_IsActiveFlag_OBLRST() )
  {
    /* The SRAM1 content is kept on Software Reset. First address of the SRAM1 indicates which kind of action has been requested */

    /* First, verify if FW App is valid */
    lEndAppFwAddress = CheckFwAppValidity();

    /* Check Boot Mode from SRAM1 */
    if ( FUOTA_OTA_REBOOT_MSG == FUOTA_REBOOT_ON_APP_FW )
    {
      /* The user has requested to start on the firmware application */
      if ( lEndAppFwAddress != 0u )
      {
        /* The FW application is a valid application. Verify if a valid application is also ready in the download slot and copy it */
        MoveToActiveSlot( lEndAppFwAddress );

        /* Jump now on the application */
        JumpFwApp();
      }
      else
      {
        /* Firmware application is no valid application. Request to reboot on Application Install Manager */
        FUOTA_OTA_REBOOT_MSG = FUOTA_REBOOT_ON_UPDATE_FW;

        /* Reboot on Update FW */
        NVIC_SystemReset();
      }
    }
    else
    {
      if ( FUOTA_OTA_REBOOT_MSG == FUOTA_REBOOT_ON_UPDATE_FW )
      {
        /* Update Required. Verify if a valid application is also ready in the download slot and copy it */
        MoveToActiveSlot( lEndAppFwAddress );

        /* Jump to Fw application */
        if ( CheckFwAppValidity() != 0u )
        {
            JumpFwApp();
        }
      }
      else
      {
        /**
         * There should be no use case to be there because the device already starts from power up
         * and the SRAM1 is then filled with the value define by the user
         * However, it could be that a reset occurs just after a power up and in that case,
         * App Install Manager will be running but the sectors to download a new App may not be erased
         */
        JumpSelectionOnPowerUp( );
      }
    }
  }
  else
  {
    /* By default, Jump after Power On */
    JumpSelectionOnPowerUp();
  }
}

/**
 * @brief   Verify if FW application is valid.
 *
 * @return  0 if FW App not valid, else end of FW Application address.
 */
uint32_t CheckFwAppValidity( void )
{
  uint32_t  lMagicKeywordAddress, lEndFwAddress = 0;
  uint32_t  lEndFlashAddress;

  lMagicKeywordAddress = *(uint32_t *)( FUOTA_APP_FW_BINARY_ADDRESS + FUOTA_APP_FW_TAG_OFFSET );
  lEndFlashAddress = ( FLASH_BASE + FLASH_SIZE ) - 4u;

  if ( ( lMagicKeywordAddress >= FLASH_BASE) && ( lMagicKeywordAddress <= lEndFlashAddress ) )
  {
    if( ( *(uint32_t*)lMagicKeywordAddress) == FUOTA_MAGIC_KEYWORD_END_APPLI  )
    {
      /* The firmware application is available */
      lEndFwAddress = lMagicKeywordAddress + 4u;
    }
  }

  return lEndFwAddress;
}

/**
 * @brief   Verify if FW Downloaded is valid.
 *
 * @return  0 if FW App not valid, else end of FW Download address.
 */
uint32_t CheckFwDownloadedValidity( void )
{
  uint32_t  lMagicKeywordAddress, lEndFwAddress = 0;
  uint32_t  lEndFlashAddress;

  lMagicKeywordAddress = *(uint32_t *)( FUOTA_APP_DOWNLOAD_BINARY_ADDRESS + FUOTA_APP_FW_TAG_OFFSET );
  lMagicKeywordAddress = lMagicKeywordAddress + ( FUOTA_APP_DOWNLOAD_BINARY_ADDRESS - FUOTA_APP_FW_BINARY_ADDRESS );
  lEndFlashAddress = ( FLASH_BASE + FLASH_SIZE ) - 4u;

  if ( ( lMagicKeywordAddress >= FLASH_BASE) && ( lMagicKeywordAddress <= lEndFlashAddress ) )
  {
    if( ( *(uint32_t*)lMagicKeywordAddress) == FUOTA_MAGIC_KEYWORD_END_APPLI  )
    {
      /* The firmware application is available */
      lEndFwAddress = lMagicKeywordAddress + 4u;
    }
  }

  return lEndFwAddress;
}

/**
 * Jump to existing FW App in flash
 * It never returns
 */
void JumpFwApp( void )
{
  ResetHandler_t   fAppResetHandler;

  SCB->VTOR = FUOTA_APP_FW_BINARY_ADDRESS;
  __set_MSP( *(uint32_t*)( FUOTA_APP_FW_BINARY_ADDRESS ) );
  fAppResetHandler = (ResetHandler_t)(*(uint32_t*)( FUOTA_APP_FW_BINARY_ADDRESS + 4u) );
  fAppResetHandler();

  /**
   * fAppResetHandler() never returns.
   * However, if for any reason a PUSH instruction is added at the entry of  JumpFwApp(),
   * we need to make sure the POP instruction is not there before fAppResetHandler() is called
   * The way to ensure this is to add a dummy code after fAppResetHandler() is called
   * This prevents fAppResetHandler() to be the last code in the function.
   */
  __WFI();
}

/**
 * Erase active or download slot
 */
static void DeleteSlot( uint32_t lStartAddress, uint32_t lEndAddress )
{
  /* It shall be checked whether the number of sectors to erase does not overlap on the secured Flash
   * The limit can be read from the SFSA option byte which provides the first secured sector address. */
  FLASH_EraseInitTypeDef stEraseInit;
  uint32_t lPageError;

  if ( lStartAddress < FUOTA_APP_FW_BINARY_ADDRESS )
  {
      /* Something has been wrong as there is no case we should delete the Zigbee_BootMngr application. Reboot on the active firmware application */
      FUOTA_OTA_REBOOT_MSG = FUOTA_REBOOT_ON_APP_FW;
      NVIC_SystemReset();
  }

  stEraseInit.TypeErase = FLASH_TYPEERASE_PAGES;
  stEraseInit.Page = (uint32_t)( ( lStartAddress - FLASH_BASE ) / FLASH_PAGE_SIZE );
  stEraseInit.NbPages = (uint32_t)( ( lEndAddress - lStartAddress ) / FLASH_PAGE_SIZE );
  if ( ( ( lEndAddress - lStartAddress ) % FLASH_PAGE_SIZE ) != 0u )
  {
      stEraseInit.NbPages++;
  }

#if defined(FLASH_DBANK_SUPPORT)
  stEraseInit.Banks = FUOTA_APP_DOWNLOAD_BINARY_BANK;
#endif

  /* Clear all Flash flags before write operation*/
  __HAL_FLASH_CLEAR_FLAG(FLASH_FLAG_ALL_ERRORS);

  HAL_FLASH_Unlock();
  HAL_FLASHEx_Erase( &stEraseInit, &lPageError );
  HAL_FLASH_Lock();
}

/**
 * Move download slot to active slot
 */
static void CopyToActiveSlot( uint32_t lAppliStartAddress, uint32_t lDownloadedStartAddress, uint32_t lDownloadedEndAddress )
{
  HAL_StatusTypeDef   eStatus;
  uint32_t            lAppliAddress, lDownloadedAddress;

  /* The flash is written by bunch of 16 bytes. Data are written in flash as long as there are at least 16 bytes */
  lAppliAddress = lAppliStartAddress;
  lDownloadedAddress = lDownloadedStartAddress;
  while ( lDownloadedAddress <= lDownloadedEndAddress )
  {
    /* Clear all Flash flags before write operation*/
    __HAL_FLASH_CLEAR_FLAG(FLASH_FLAG_ALL_ERRORS);

    HAL_FLASH_Unlock();
    do
    {
      eStatus = HAL_FLASH_Program( FLASH_TYPEPROGRAM_QUADWORD, lAppliAddress, lDownloadedAddress );
    }
    while ( eStatus != HAL_OK);
    HAL_FLASH_Lock();

    if ( ( *(uint64_t *)(lAppliAddress) == *(uint64_t *)(lDownloadedAddress) ) && ( *(uint64_t *)( lAppliAddress + 8u ) == *(uint64_t *)( lDownloadedAddress + 8u ) ) )
    {
      lAppliAddress += 16;
      lDownloadedAddress += 16;
    }
  }
}

static void MoveToActiveSlot( uint32_t lEndAppFwAddress )
{
  uint32_t  lEndDownloadFwAddress, lDownloadFwSize;

  /* It has been requested to reboot on App Install Manager application to transfer data. */
  lEndDownloadFwAddress = CheckFwDownloadedValidity();
  if ( lEndDownloadFwAddress != 0u )
  {
    /* If End of Application FW address not found, erase until Download Zone */
    if ( lEndAppFwAddress == 0u )
    {
      lEndAppFwAddress = FUOTA_APP_DOWNLOAD_BINARY_ADDRESS - 1u;
    }

    /* Erase active slot */
    lDownloadFwSize = lEndDownloadFwAddress - FUOTA_APP_DOWNLOAD_BINARY_ADDRESS;
    DeleteSlot( FUOTA_APP_FW_BINARY_ADDRESS, ( FUOTA_APP_FW_BINARY_ADDRESS + lDownloadFwSize ) );

    /* Move download slot to active slot */
    CopyToActiveSlot( FUOTA_APP_FW_BINARY_ADDRESS, FUOTA_APP_DOWNLOAD_BINARY_ADDRESS, lEndDownloadFwAddress );

    if ( CheckFwAppValidity() != 0u )
    {
      /* Erase download slot */
      DeleteSlot( FUOTA_APP_DOWNLOAD_BINARY_ADDRESS, lEndDownloadFwAddress );
    }
  }
}

static void JumpSelectionOnPowerUp( void )
{
  /* Check if there is a FW App */
  if ( CheckFwAppValidity() != 0u )
  {
      /* The SRAM1 is random. Initialize SRAM1 to indicate we requested to reboot of firmware application */
      FUOTA_OTA_REBOOT_MSG = FUOTA_REBOOT_ON_APP_FW;

      /* A valid application is available. Jump now on the application */
      JumpFwApp();
  }
  else
  {
      /* The SRAM1 is random. Initialize SRAM1 to indicate we requested to reboot of Install Manager application */
      FUOTA_OTA_REBOOT_MSG = FUOTA_REBOOT_ON_UPDATE_FW;
  }
}

/* USER CODE END 4 */

void Error_Handler(void)
{
  __disable_irq();
  while (1)
  {
  }
}
